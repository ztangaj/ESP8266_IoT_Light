//
//#include <Arduino.h>
//#include <U8g2lib.h>
//
//#ifdef U8X8_HAVE_HW_SPI
//#include <SPI.h>
//#endif
//#ifdef U8X8_HAVE_HW_I2C
//#include <Wire.h>
//#endif
//U8G2_SSD1306_128X64_NONAME_F_SW_I2C u8g2(U8G2_R0, /* clock=*/ SCL, /* data=*/ SDA, /* reset=*/ U8X8_PIN_NONE);   // All Boards without Reset of the Display

#define htc_width 128
#define htc_height 64
static const unsigned char htc_bits[] PROGMEM  = {
0x0,0xf0,0x7,0x0,0x0,0x0,0x0,0x0,0x0,0x0,0x0,0x0,0x0,0x0,0x0,0x0,
0x0,0xf0,0x7,0x0,0x0,0x0,0x0,0x0,0x0,0x0,0x0,0x0,0x0,0x0,0x0,0x0,
0x0,0xf0,0x7,0x0,0x0,0x0,0x0,0x0,0x0,0x0,0x0,0x0,0x0,0x0,0x0,0x0,
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0x0,0x2,0x0,0x0,0x0,0x0,0x1c,0x0,0x0,0x0,0x0,0x0,0x0,0x0,0x0,0x0,
};

#include <Adafruit_ssd1306syp.h>
#define SDA_PIN 4
#define SCL_PIN 5
#include <Servo.h>

Servo servo;
Adafruit_ssd1306syp display(SDA_PIN,SCL_PIN);

int timecount = 0;

#include <ESP8266WiFi.h>
#include <WiFiClient.h>
#include <ESP8266HTTPClient.h>

#include <ArduinoJson.h>

//const char* ssid = "HTC Portable Hotspot D1AA";
//const char* password = "00000000";
const char* ssid = "WSM";
const char* password = "88981199";
int switch_open = 0; //Switch
int switch_last = 0; //Last Status
int switch_trigger = 0; //Switch trigger
int first_start = 0; //status of first

void setup() {
  //Display

//  u8g2.begin();
//  u8g2.enableUTF8Print();
  
  display.initialize();
  display.clear();
  display.setTextColor(WHITE);
  display.setTextSize(4);
  display.setCursor(40,13);
  display.print("h");
  display.setTextSize(3);
  display.setCursor(63,20);
  display.print("TC");
  display.update();
//  u8g2.clearBuffer();
//  u8g2.setDrawColor(1);
//  u8g2.drawXBM(0,0,htc_width,htc_height,htc_bits);//印出圖形(x,y,w,h,bitmap)
//  u8g2.sendBuffer();
  delay(1000);
  
  //Servo
  servo.attach(15);
  servo.write(42);

  //WIFI server
  Serial.begin(115200);
  display.clear();
  display.setTextSize(2);
  display.setCursor(0,0);
  delay(10);

  // prepare GPIO2
  pinMode(LED_BUILTIN, OUTPUT);
  digitalWrite(LED_BUILTIN, 0);//2 is D4
  
  // Connect to WiFi network
  Serial.println();
  Serial.println();
  Serial.print("Connecting to ");
  display.print("Connecting to ");
//  u8g2.setFont(u8g2_font_9x18B_mr );//設定字型
//  u8g2.clearBuffer();
//  u8g2.setCursor(0,16);
//  u8g2.print("Connecting to ");
//  u8g2.setCursor(0,32);
//  u8g2.print(ssid);
//  u8g2.sendBuffer();
  Serial.println(ssid);
  display.println(ssid);
  display.update();
  
  WiFi.begin(ssid, password);
  int wait_time = 0;
  
  while (WiFi.status() != WL_CONNECTED) {
    delay(500);
    Serial.print(".");
//    u8g2.setCursor(wait_time,48);
//    wait_time+=4;
//    u8g2.print(".");
//    u8g2.sendBuffer();
    
    display.print(".");
    display.update();
  }
  Serial.println("");
  Serial.println("WiFi connected");
  display.clear();
  display.setCursor(0,0);
  display.print(ssid);
  display.println(" done");
  display.update();
//  u8g2.clearBuffer();
//  u8g2.setCursor(0,16);
//  u8g2.print(ssid);
//  u8g2.sendBuffer();
  
  digitalWrite(LED_BUILTIN,1);

  // Print the IP address
  Serial.println(WiFi.localIP());
  display.println(WiFi.localIP());
  display.update();
//  u8g2.setCursor(0,32);
//  u8g2.print(WiFi.localIP());
//  u8g2.sendBuffer();
}

void(*resetFunc)(void)=0;//declare reset function at address 0
int flip = 0;

void loop() {
  delay(1);
  timecount++;
  if (timecount>=3000){
    timecount=0;
    //resetFunc();
  }
    //Display
  display.clear();
  display.setTextSize(2);
  display.setCursor(0,0);
  display.println(ssid);
  //display.print(WiFi.localIP());
  display.println(switch_open ==0 ? " close" : " open");
//  display.drawCircle(timecount/5%128,59,3,WHITE);
  display.drawCircle(64,64,timecount%37,WHITE);
  if (timecount%64>32){
    display.drawCircle(100,60,timecount%64-32,WHITE);
    display.drawCircle(28,60,timecount%64-32,WHITE);
  }
  display.setTextSize(2);
  display.update();
//  u8g2.clearBuffer();
//  u8g2.setCursor(0,16);
//  u8g2.print(ssid);
//  u8g2.setCursor(0,32);
//  u8g2.print(WiFi.localIP());
//  u8g2.setCursor(0,48);
//  u8g2.drawCircle(64,64,timecount%37);
//  if (timecount%64>32){
//    u8g2.drawCircle(100,60,timecount%64-32);
//    u8g2.drawCircle(28,60,timecount%64-32);
//  }
//  u8g2.sendBuffer();

  switch_trigger = 0;

  
  // Check WiFi Status
  if (WiFi.status() == WL_CONNECTED) {
    HTTPClient http;  //Object of class HTTPClient
    http.begin("http://zonicspaceworkshop.com/Iot/Light");
    int httpCode = http.GET();
    //Check the returning code                                                                  
    if (httpCode > 0) {
      // Get the request response payload
      String payload = http.getString();
      // TODO: Parsing
      StaticJsonBuffer<200> jsonBuffer;
      JsonObject& root = jsonBuffer.parseObject(payload);
      if (!root.success()){
        Serial.println("parseObject() failed");
        return;
      }
      const char* Switch = root["Switch"];
      Serial.println(Switch);
      
      if(strcmp(Switch,"Close")==0){
        switch_open = 0;
      }
      else if(strcmp(Switch,"Open")==0){
        switch_open = 1;
      }
      else {
        first_start = 0;
      }
      if(first_start !=0){
        switch_trigger = switch_open - switch_last;
      }
      Serial.print("Trigger: ");
      Serial.println(switch_trigger);
      switch_last = switch_open;
      //digitalWrite(LED_BUILTIN, switch_trigger);
        
      // Match the request
      int val;
      if(switch_trigger == -1){
        val = 0;
        flip = 0;
        servo.write(10);
        Serial.println(10);
        delay(200);
        servo.write(42);
      }
      else if(switch_trigger == 1){
        val = 1;
        flip = 1;
        servo.write(74);
        Serial.println(74);
        delay(200);
        servo.write(42);
      }
      digitalWrite(LED_BUILTIN, val);
      Serial.println(payload);
      display.clear();
      display.setCursor(0,0);
      display.print(Switch);
      display.print(switch_open);
      display.update();
      first_start = 1;
    }
    http.end();   //Close connection
  }
  delay(500);
}
